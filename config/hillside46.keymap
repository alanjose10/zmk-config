#include <behaviors.dtsi>
#include <dt-bindings/zmk/bt.h>
#include <dt-bindings/zmk/ext_power.h>
#include <dt-bindings/zmk/keys.h>
#include <dt-bindings/zmk/outputs.h>

#include "zmk-helpers/helper.h"
#include "zmk-helpers/key-labels/hillside46.h"

#include "hillside-common.dtsi"
#include "mouse.dtsi"

// Layers, same order as the charybdis colemak_dh keymap.
#define BASE      0
#define NAV       1
#define SYM       2
#define SHORTCUTS 3
#define ADJ       4   // SHORTCUTS + NAV
#define SYSTEM    5   // SYM + NAV

#include "shortcuts.dtsi"
#include "hillside-ht.dtsi"

ZMK_CONDITIONAL_LAYER(adjust_layer, SHORTCUTS NAV, ADJ)
ZMK_CONDITIONAL_LAYER(system_layer, SYM NAV, SYSTEM)

/* --- CAFFEINE (key 37) ---
   Every INTERVAL the pointer moves one leg of a square (up, left, down,
   right in turn), so the loop closes every four ticks. TAP is the length of
   each leg. Any keycode press turns caffeine off. */
#define CAFFEINE_INTERVAL_MS 1000
#define CAFFEINE_TAP_MS      400

&lt {
    tapping-term-ms = <220>;
    quick-tap-ms = <190>;
};

/ {
    behaviors {
        thumb_mt: mod_tap {
            compatible = "zmk,behavior-hold-tap";
            #binding-cells = <2>;
            flavor = "hold-preferred";
            tapping-term-ms = <220>;
            quick-tap-ms = <190>;
            bindings = <&kp>, <&kp>;
            display-name = "Thumb-Mod-Tap";
        };

        ca: caffeine {
            compatible = "zmk,behavior-caffeine";
            #binding-cells = <0>;
            bindings = <&mmv MOVE_UP>, <&mmv MOVE_LEFT>,
                       <&mmv MOVE_DOWN>, <&mmv MOVE_RIGHT>;
            mode = "rotate";
            interval-ms = <CAFFEINE_INTERVAL_MS>;
            tap-ms = <CAFFEINE_TAP_MS>;
            cancel-on-keypress;
            display-name = "Caffeine";
        };
    };

    keymap {
        compatible = "zmk,keymap";

        /* Rows: 6+6, 6+6, 6+1 | 1+6, 4 | 4. Keys 30, 31, 38, 44 and 45 have no
           charybdis counterpart and keep their hillside bindings. */

        base_layer {
            display-name = "BASE";
            bindings = <
    &key_repeat   &kp Q         &kp W         &kp F         &kp P         &kp B                                       &kp J         &kp L         &kp U         &kp Y         &kp SEMI      &caps_word
    &kp BSPC      &kp A         &hml LCTRL R  &hml LALT S   &hml LGUI T   &kp G                                       &kp M         &hmr RGUI N   &hmr RALT E   &hmr RCTRL I  &kp O         &kp RSHIFT
    &kp RET       &kp Z         &kp X         &kp C         &kp D         &kp V         &kp ENTER         &kp CAPS      &kp K         &kp H         &kp COMMA     &kp DOT       &kp SLASH     &ca
                                              &kp BSPC      &lt SYM TAB   &thumb_mt LSHIFT SPACE  &lt SHORTCUTS ESC     &lt NAV ENTER  &thumb_mt RSHIFT BSPC  &lt SYM DEL  &none
            >;
        };

        nav_layer {
            display-name = "NAV";
            bindings = <
    &none         &none         &msc SCRL_RIGHT &mmv MOVE_UP  &msc SCRL_LEFT &none                                     DesktopLeft   &mkp LCLK     &mkp RCLK     DesktopRight  &none         &none
    &none         &none         &mmv MOVE_LEFT &mmv MOVE_DOWN &mmv MOVE_RIGHT &none                                    &kp LEFT      &kp DOWN      &kp UP        &kp RIGHT     &none         &none
    &none         &none         &msc SCRL_UP  &none         &msc SCRL_DOWN &none        &trans            &none         &kp HOME      &kp PG_DN     &kp PG_UP     &kp END       &none         &none
                                              &trans        &trans        &trans        &trans            &trans        &trans        &trans        &trans
            >;
        };

        sym_layer {
            display-name = "SYM";
            bindings = <
    &none         &kp PIPE      &kp AT        &kp LBKT      &kp RBKT      &none                                       &none         &kp N7        &kp N8        &kp N9        &none         &none
    &none         &kp CARET     &hmr RCTRL DLLR &hmr RALT LBRC &hmr RGUI RBRC &none                                   &none         &hmr RGUI N1  &hmr RALT N2  &hmr RCTRL N3 &kp N0        &none
    &none         &kp BSLH      &kp HASH      &kp LPAR      &kp RPAR      &none         &trans            &none         &none         &kp N4        &kp N5        &kp N6        &none         &none
                                              &trans        &trans        &trans        &trans            &trans        &trans        &trans        &trans
            >;
        };

        shortcuts_layer {
            display-name = "SHORT";
            bindings = <
    &none         Previous      Back          Forward       Next          &none                                       &none         &none         &none         &none         &none         &none
    &none         SelectAll     Save          &none         Find          &none                                       &none         &none         &none         &none         &none         &none
    &none         Undo          Cut           Copy          Paste         &none         &trans            &none         &none         &none         &none         &none         &none         &none
                                              &trans        &trans        &trans        &trans            &trans        &trans        &trans        &trans
            >;
        };

        adj_layer {
            display-name = "ADJ";
            bindings = <
    &none         &none         &none         &none         &none         &none                                       &none         &kp C_BRI_DN  &kp C_BRI_UP  &none         &none         &none
    &none         &none         &none         &none         &none         &none                                       &none         &kp C_VOL_DN  &kp C_VOL_UP  &kp C_MUTE    &none         &none
    &none         &none         &none         &none         &none         &none         &none             &none         &none         &kp F23       &kp F24       &none         &none         &none
                                              &trans        &trans        &trans        &trans            &trans        &trans        &trans        &trans
            >;
        };

        system_layer {
            display-name = "SYS";
            bindings = <
    &none         &none         &none         &none         &none         &none                                       &none         &out OUT_USB  &out OUT_BLE  &ext_power EP_OFF &ext_power EP_ON &none
    &none         &bt BT_SEL 0  &bt BT_SEL 1  &bt BT_SEL 2  &bt BT_SEL 3  &bt BT_SEL 4                                &none         &none         &none         &none         &none         &bt BT_CLR
    &bootloader   &none         &none         &none         &none         &none         &none             &bt BT_CLR_ALL &none        &none         &none         &none         &none         &bootloader
                                              &trans        &trans        &trans        &trans            &trans        &trans        &trans        &trans
            >;
        };
    };
};

#include "hillside-combos.dtsi"
