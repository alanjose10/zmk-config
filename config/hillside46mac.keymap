#include <behaviors.dtsi>
#include <dt-bindings/zmk/bt.h>
#include <dt-bindings/zmk/ext_power.h>
#include <dt-bindings/zmk/keys.h>
#include <dt-bindings/zmk/outputs.h>

#include "zmk-helpers/helper.h"
#include "zmk-helpers/key-labels/hillside46.h"

#include "hillside-common.dtsi"

#include "mouse.dtsi"

// Layers
#define MAC_L           0
#define SYMBOL_L        1
#define NAV_MAC_L       2
#define SHORTCUTS_MAC_L 3
#define ADJ_L           4
#define SYSTEM_L        5

// Aliases for combo file
#define BASE_L MAC_L
#define NAV_L  NAV_MAC_L

#include "shortcuts.dtsi"
#include "macros.dtsi"
#include "hillside-ht.dtsi"

ZMK_CONDITIONAL_LAYER(adjust_layer, SHORTCUTS_MAC_L NAV_MAC_L, ADJ_L)
ZMK_CONDITIONAL_LAYER(system_layer, SYMBOL_L NAV_MAC_L, SYSTEM_L)

&mt {
    tapping-term-ms = <200>;
    quick-tap-ms = <175>;
};

&lt {
    tapping-term-ms = <220>;
    quick-tap-ms = <190>;
};

/ {
    behaviors {
        thumb_mt: mod_tap {
            compatible = "zmk,behavior-hold-tap";
            #binding-cells = <2>;
            flavor = "hold-preferred";
            tapping-term-ms = <220>;
            quick-tap-ms = <190>;
            bindings = <&kp>, <&kp>;
            display-name = "Thumb-Mod-Tap";
        };
    };
};

/ {

    keymap {
        compatible = "zmk,keymap";

        mac_hrm_layer {
            display-name = "MAC";
            /* Mac (Cmd) COLEMAK-DH with home row mods */

            bindings = <
// ╭────────────────────────┬────────────────────────┬────────────────────────┬────────────────────────┬────────────────────────┬────────────────────────╮                                                                                                         ╭────────────────────────┬────────────────────────┬────────────────────────┬───────────────────────┬────────────────────────┬────────────────────────╮
    &key_repeat              &kp Q                    &kp W                    &kp F                    &kp P                    &kp B                                                                                                                              &kp J                    &kp L                    &kp U                    &kp Y                   &kp SEMI                 &caps_word
// ├────────────────────────┼────────────────────────┼────────────────────────┼────────────────────────┼────────────────────────┼────────────────────────┤                                                                                                         ├────────────────────────┼────────────────────────┼────────────────────────┼───────────────────────┼────────────────────────┼────────────────────────┤
    &kp LSHIFT               &kp A                    &hml LCTRL R             &hml LALT S              &hml LGUI T              &kp G                                                                                                                              &kp M                    &hmr RGUI N              &hmr RALT E              &hmr RCTRL I            &kp O                    &kp RSHIFT
// ├────────────────────────┼────────────────────────┼────────────────────────┼────────────────────────┼────────────────────────┼────────────────────────┬────────────────────────╮                                                       ╭────────────────────────┬────────────────────────┼────────────────────────┼────────────────────────┼───────────────────────┼────────────────────────┼────────────────────────┤
    &none                    &kp Z                    &kp X                    &kp C                    &kp D                    &kp V                    &kp ENTER                                                                        &kp CAPS                 &kp K                    &kp H                    &kp COMMA                &kp DOT                  &kp SLASH               &none
// ├────────────────────────┼────────────────────────┼────────────────────────┼────────────────────────┼────────────────────────┼────────────────────────┬────────────────────────┬────────────────────────╮     ╭────────────────────────┬────────────────────────┼────────────────────────┼────────────────────────┼────────────────────────┼───────────────────────┼────────────────────────┼────────────────────────┤
                                                                                                        &kp BSPC                 &lt SYMBOL_L TAB         &thumb_mt LSHIFT SPACE   &lt SHORTCUTS_MAC_L ESC            &lt NAV_MAC_L ENTER      &thumb_mt RSHIFT BSPC    &lt SYMBOL_L DEL         &none
//                                                                                                     ╰────────────────────────┴────────────────────────┴────────────────────────┴────────────────────────╯     ╰────────────────────────┴────────────────────────┴────────────────────────┴────────────────────────╯
            >;
        };

        symbol_layer {
            display-name = "SYMB";
            /* Symbols and Numbers*/

            bindings = <

// ╭────────────────────────┬────────────────────────┬────────────────────────┬────────────────────────┬────────────────────────┬────────────────────────╮                                                                                                         ╭────────────────────────┬────────────────────────┬────────────────────────┬───────────────────────┬────────────────────────┬────────────────────────╮
    &none                    &kp PIPE                 &kp AT                   &kp LBKT                 &kp RBKT                 &none                                                                                                                              &none                    &kp N7                   &kp N8                   &kp N9                  &none                    &none
// ├────────────────────────┼────────────────────────┼────────────────────────┼────────────────────────┼────────────────────────┼────────────────────────┤                                                                                                         ├────────────────────────┼────────────────────────┼────────────────────────┼───────────────────────┼────────────────────────┼────────────────────────┤
    &none                    &kp CARET                &hmr RCTRL DLLR          &hmr RALT LBRC           &hmr RGUI RBRC           &none                                                                                                                              &none                    &hmr RGUI N1             &hmr RALT N2             &hmr RCTRL N3           &kp N0                   &none
// ├────────────────────────┼────────────────────────┼────────────────────────┼────────────────────────┼────────────────────────┼────────────────────────┬────────────────────────╮                                                       ╭────────────────────────┬────────────────────────┼────────────────────────┼────────────────────────┼───────────────────────┼────────────────────────┼────────────────────────┤
    &none                    &kp BACKSLASH            &kp HASH                 &kp LPAR                 &kp RPAR                 &none                    &trans                                                                           &none                    &none                    &kp N4                   &kp N5                   &kp N6                  &none                    &none
// ├────────────────────────┼────────────────────────┼────────────────────────┼────────────────────────┼────────────────────────┼────────────────────────┬────────────────────────┬────────────────────────╮     ╭────────────────────────┬────────────────────────┼────────────────────────┼────────────────────────┼────────────────────────┼───────────────────────┼────────────────────────┼────────────────────────┤
                                                                                                        &trans                   &trans                   &trans                   &trans                         &trans                   &trans                   &trans                   &trans
//                                                                                                     ╰────────────────────────┴────────────────────────┴────────────────────────┴────────────────────────╯     ╰────────────────────────┴────────────────────────┴────────────────────────┴────────────────────────╯
            >;

        };

        nav_mac_layer {
            display-name = "NAV-MAC";
            /* Navigation and Mouse - Mac/Windows style */

            bindings = <
// ╭────────────────────────┬────────────────────────┬────────────────────────┬────────────────────────┬────────────────────────┬────────────────────────╮                                                                                                         ╭────────────────────────┬────────────────────────┬────────────────────────┬───────────────────────┬────────────────────────┬────────────────────────╮
    &none                    &none                    &msc SCRL_RIGHT          &mmv MOVE_UP             &msc SCRL_LEFT           &none                                                                                                                              DesktopLeft              &mkp LCLK                &mkp RCLK                DesktopRight            &none                    &none
// ├────────────────────────┼────────────────────────┼────────────────────────┼────────────────────────┼────────────────────────┼────────────────────────┤                                                                                                         ├────────────────────────┼────────────────────────┼────────────────────────┼───────────────────────┼────────────────────────┼────────────────────────┤
    &none                    &none                    &mmv MOVE_LEFT           &mmv MOVE_DOWN           &mmv MOVE_RIGHT          &none                                                                                                                              &kp LEFT                 &kp DOWN                 &kp UP                   &kp RIGHT               &none                    &none
// ├────────────────────────┼────────────────────────┼────────────────────────┼────────────────────────┼────────────────────────┼────────────────────────┬────────────────────────╮                                                       ╭────────────────────────┬────────────────────────┼────────────────────────┼────────────────────────┼───────────────────────┼────────────────────────┼────────────────────────┤
    &none                    &none                    &msc SCRL_UP             &none                    &msc SCRL_DOWN           &none                    &trans                                                                           &none                    &kp HOME                 &kp PG_DN                &kp PG_UP                &kp END                 &none                    &none
// ├────────────────────────┼────────────────────────┼────────────────────────┼────────────────────────┼────────────────────────┼────────────────────────┬────────────────────────┬────────────────────────╮     ╭────────────────────────┬────────────────────────┼────────────────────────┼────────────────────────┼────────────────────────┼───────────────────────┼────────────────────────┼────────────────────────┤
                                                                                                        &trans                   &trans                   &trans                   &trans                         &trans                   &trans                   &trans                   &trans
//                                                                                                     ╰────────────────────────┴────────────────────────┴────────────────────────┴────────────────────────╯     ╰────────────────────────┴────────────────────────┴────────────────────────┴────────────────────────╯
            >;

        };

        shortcuts_mac_layer {
            display-name = "SHORT-MAC";
            /* Mac shortcuts */

            bindings = <
// ╭────────────────────────┬────────────────────────┬────────────────────────┬────────────────────────┬────────────────────────┬────────────────────────╮                                                                                                         ╭────────────────────────┬────────────────────────┬────────────────────────┬───────────────────────┬────────────────────────┬────────────────────────╮
    &none                    Previous                 Back                     Forward                  Next                     &none                                                                                                                              &none                    &none                    &none                    &none                   &none                    &none
// ├────────────────────────┼────────────────────────┼────────────────────────┼────────────────────────┼────────────────────────┼────────────────────────┤                                                                                                         ├────────────────────────┼────────────────────────┼────────────────────────┼───────────────────────┼────────────────────────┼────────────────────────┤
    &none                    SelectAll                Save                     &none                    Find                     &none                                                                                                                              &none                    &none                    &none                    &none                   &none                    &none
// ├────────────────────────┼────────────────────────┼────────────────────────┼────────────────────────┼────────────────────────┼────────────────────────┬────────────────────────╮                                                       ╭────────────────────────┬────────────────────────┼────────────────────────┼────────────────────────┼───────────────────────┼────────────────────────┼────────────────────────┤
    &none                    Undo                     Cut                      Copy                     Paste                    &none                    &trans                                                                           &none                    &none                    &none                    &none                    &none                   &none                    &none
// ├────────────────────────┼────────────────────────┼────────────────────────┼────────────────────────┼────────────────────────┼────────────────────────┬────────────────────────┬────────────────────────╮     ╭────────────────────────┬────────────────────────┼────────────────────────┼────────────────────────┼────────────────────────┼───────────────────────┼────────────────────────┼────────────────────────┤
                                                                                                        &trans                   &trans                   &trans                   &trans                         &trans                   &trans                   &trans                   &trans
//                                                                                                     ╰────────────────────────┴────────────────────────┴────────────────────────┴────────────────────────╯     ╰────────────────────────┴────────────────────────┴────────────────────────┴────────────────────────╯
            >;
        };

        adj_layer {
            display-name = "ADJ";
            /* Adjustments */

            bindings = <
// ╭────────────────────────┬────────────────────────┬────────────────────────┬────────────────────────┬────────────────────────┬────────────────────────╮                                                                                                         ╭────────────────────────┬────────────────────────┬────────────────────────┬───────────────────────┬────────────────────────┬────────────────────────╮
    &none                    &none                    &none                    &none                    &none                    &none                                                                                                                              &none                    &kp C_BRI_DN             &kp C_BRI_UP             &none                   &none                    &none
// ├────────────────────────┼────────────────────────┼────────────────────────┼────────────────────────┼────────────────────────┼────────────────────────┤                                                                                                         ├────────────────────────┼────────────────────────┼────────────────────────┼───────────────────────┼────────────────────────┼────────────────────────┤
    &none                    &none                    &none                    &none                    &none                    &none                                                                                                                              &none                    &kp C_VOL_DN             &kp C_VOL_UP             &kp C_MUTE              &none                    &none
// ├────────────────────────┼────────────────────────┼────────────────────────┼────────────────────────┼────────────────────────┼────────────────────────┬────────────────────────╮                                                       ╭────────────────────────┬────────────────────────┼────────────────────────┼────────────────────────┼───────────────────────┼────────────────────────┼────────────────────────┤
     &none                      &none                   &none                   &none                   &none                       &none                      &none                                                                         &none                   &none                   &kp F23                  &kp F24                  &none                    &none                  &none
// ├────────────────────────┼────────────────────────┼────────────────────────┼────────────────────────┼────────────────────────┼────────────────────────┬────────────────────────┬────────────────────────╮     ╭────────────────────────┬────────────────────────┼────────────────────────┼────────────────────────┼────────────────────────┼───────────────────────┼────────────────────────┼────────────────────────┤
                                                                                                        &trans                   &trans                   &trans                   &trans                         &trans                   &trans                   &trans                   &trans
//                                                                                                     ╰────────────────────────┴────────────────────────┴────────────────────────┴────────────────────────╯     ╰────────────────────────┴────────────────────────┴────────────────────────┴────────────────────────╯
            >;

        };

        system_layer {
            display-name = "SYS";
            /* Bluetooth and System layer */

            bindings = <
// ╭────────────────────────┬────────────────────────┬────────────────────────┬────────────────────────┬────────────────────────┬────────────────────────╮                                                                                                         ╭────────────────────────┬────────────────────────┬────────────────────────┬───────────────────────┬────────────────────────┬────────────────────────╮
    &none                    &none                    &none                    &none                    &none                    &none                                                                                                                              &none                    &out OUT_USB             &out OUT_BLE             &ext_power EP_OFF       &ext_power EP_ON         &none
// ├────────────────────────┼────────────────────────┼────────────────────────┼────────────────────────┼────────────────────────┼────────────────────────┤                                                                                                         ├────────────────────────┼────────────────────────┼────────────────────────┼───────────────────────┼────────────────────────┼────────────────────────┤
    &none                    &bt BT_SEL 0             &bt BT_SEL 1             &bt BT_SEL 2             &bt BT_SEL 3             &bt BT_SEL 4                                                                                                                       &none                    &none                    &none                    &none                   &none                    &none
// ├────────────────────────┼────────────────────────┼────────────────────────┼────────────────────────┼────────────────────────┼────────────────────────┬────────────────────────╮                                                       ╭────────────────────────┬────────────────────────┼────────────────────────┼────────────────────────┼───────────────────────┼────────────────────────┼────────────────────────┤
    &bootloader              &none                    &none                    &none                    &none                    &none                    &bt BT_CLR                                                                       &bt BT_CLR_ALL           &none                    &none                    &none                    &none                   &none                    &bootloader
// ├────────────────────────┼────────────────────────┼────────────────────────┼────────────────────────┼────────────────────────┼────────────────────────┬────────────────────────┬────────────────────────╮     ╭────────────────────────┬────────────────────────┼────────────────────────┼────────────────────────┼────────────────────────┼───────────────────────┼────────────────────────┼────────────────────────┤
                                                                                                        &trans                   &trans                   &trans                   &trans                         &trans                   &trans                   &trans                   &trans
//                                                                                                     ╰────────────────────────┴────────────────────────┴────────────────────────┴────────────────────────╯     ╰────────────────────────┴────────────────────────┴────────────────────────┴────────────────────────╯
            >;
        };
    };
};

#include "hillside-combos.dtsi"
