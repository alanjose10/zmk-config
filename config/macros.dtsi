

/ {
    
    behaviors {
        // Sends "g" then "t" -> Vim: go to next tab
        vi_tab_next: vi_tab_next {
            compatible = "zmk,behavior-macro";
            #binding-cells = <0>;
            wait-ms = <40>;
            tap-ms = <40>;
            bindings = <
                &kp G
                &kp T
            >;
        };

        // Sends "g" then "Shift+t" -> Vim: go to previous tab
        vi_tab_prev: vi_tab_prev {
            compatible = "zmk,behavior-macro";
            #binding-cells = <0>;
            wait-ms = <40>;
            tap-ms = <40>;
            bindings = <
                &kp G
                &kp LS(T)
            >;
        };
    };
};
    
