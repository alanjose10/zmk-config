## boards/shields/kyria_rev3/Kconfig.defconfig
```kconfig
if SHIELD_KYRIA_REV3_DONGLE

# Max 16 characters in keyboard name
config ZMK_KEYBOARD_NAME
    default "Kyria"

config ZMK_SPLIT_ROLE_CENTRAL
    default y

config ZMK_SPLIT
    default y

config ZMK_SPLIT_BLE_CENTRAL_PERIPHERALS
    default 2

config BT_MAX_CONN
    default 5

config BT_MAX_PAIRED
    default 5

endif
```

## boards/shields/kyria_rev3/Kconfig.shield
```kconfig
# Copyright (c) 2023 The ZMK Contributors
# SPDX-License-Identifier: MIT

config SHIELD_KYRIA_REV3_DONGLE
    def_bool $(shields_list_contains,kyria_rev3_dongle)
```
