## boards/arm/nrf52840_mdk_dongle/Kconfig.defconfig
```kconfig
# SPDX-License-Identifier: MIT

if BOARD_NRF52840_MDK_DONGLE

config BOARD
    default "nrf52840_mdk_dongle"

if USB_DEVICE_STACK

config USB_NRFX
    default y

endif # USB_DEVICE_STACK

config BT_CTLR
    default BT

endif # BOARD_NRF52840_MDK_DONGLE
```

## boards/shields/hillside46linux/Kconfig.defconfig
```kconfig
if SHIELD_HILLSIDE46LINUX_LEFT || SHIELD_HILLSIDE46LINUX_RIGHT

config ZMK_SPLIT
    default y

endif

if SHIELD_HILLSIDE46LINUX_DONGLE

# Max 16 characters in keyboard name
config ZMK_KEYBOARD_NAME
    default "Hillside46 Lnx"

config ZMK_SPLIT_ROLE_CENTRAL
    default y

config ZMK_SPLIT
    default y

config ZMK_SPLIT_BLE_CENTRAL_PERIPHERALS
    default 2

config BT_MAX_CONN
    default 7

config BT_MAX_PAIRED
    default 7

endif
```

## boards/shields/hillside46linux/Kconfig.shield
```kconfig
config SHIELD_HILLSIDE46LINUX_LEFT
    def_bool $(shields_list_contains,hillside46linux_left)

config SHIELD_HILLSIDE46LINUX_RIGHT
    def_bool $(shields_list_contains,hillside46linux_right)

config SHIELD_HILLSIDE46LINUX_DONGLE
    def_bool $(shields_list_contains,hillside46linux_dongle)
```

## boards/shields/hillside46mac/Kconfig.defconfig
```kconfig
if SHIELD_HILLSIDE46MAC_LEFT || SHIELD_HILLSIDE46MAC_RIGHT

config ZMK_SPLIT
    default y

endif

if SHIELD_HILLSIDE46MAC_DONGLE

# Max 16 characters in keyboard name
config ZMK_KEYBOARD_NAME
    default "Hillside46 Mac"

config ZMK_SPLIT_ROLE_CENTRAL
    default y

config ZMK_SPLIT
    default y

config ZMK_SPLIT_BLE_CENTRAL_PERIPHERALS
    default 2

config BT_MAX_CONN
    default 7

config BT_MAX_PAIRED
    default 7

endif
```

## boards/shields/hillside46mac/Kconfig.shield
```kconfig
config SHIELD_HILLSIDE46MAC_LEFT
    def_bool $(shields_list_contains,hillside46mac_left)

config SHIELD_HILLSIDE46MAC_RIGHT
    def_bool $(shields_list_contains,hillside46mac_right)

config SHIELD_HILLSIDE46MAC_DONGLE
    def_bool $(shields_list_contains,hillside46mac_dongle)
```
